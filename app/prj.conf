## prj.conf
```kconfig
# Copyright (c) 2026 IAR Systems AB
# SPDX-License-Identifier: Apache-2.0
#
# This file contains selected Kconfig options for the application.

CONFIG_BLINK=y
CONFIG_BUTTON=y

# IAR Compiler Debug optimizations
CONFIG_DEBUG_OPTIMIZATIONS=y

# Console
CONFIG_CONSOLE=y
CONFIG_SEMIHOST=y
CONFIG_SEMIHOST_CONSOLE=y
CONFIG_UART_CONSOLE=n

# IAR C-SPY RTOS Awareness plugin for Zephyr
CONFIG_TRACING=y
## Enable thread visualization
CONFIG_DEBUG_THREAD_INFO=y
## Enable Mutexes and Semaphores visualization
CONFIG_TRACING_OBJECT_TRACKING=y
```

## src/thread1.c
```c
/*
 * Copyright (c) 2026 IAR Systems AB
 * SPDX-License-Identifier: Apache-2.0
 */

#include <zephyr/kernel.h>

#include <app/drivers/blink.h>

/* size of stack area */
#define STACKSIZE 1024

/* scheduling priority */
#define PRIORITY 11

/* Define semaphores for synchronization */
K_SEM_DEFINE(led1_sem, 0, 1);
extern struct k_sem led2_sem;

void blink1(void)
{
  const struct device *blink;

  blink = DEVICE_DT_GET(DT_NODELABEL(blink1_led));
  if (!device_is_ready(blink)) {
    printk("Blink 1 LED not ready\n");
    return;
  }

  while (1) {
    k_sem_take(&led1_sem, K_FOREVER);

    blink_set_period_ms(blink, 200);

    k_sem_give(&led2_sem);

    k_msleep(400);

    blink_off(blink);
  }
}

/* Define thread at compile-time */
K_THREAD_DEFINE(blink1_id, STACKSIZE, blink1, NULL, NULL, NULL,	PRIORITY, 0, 0);
```
